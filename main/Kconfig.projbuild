## main/Kconfig.projbuild
```kconfig
menu "GuangHeng Energy Companion"

config GH_BACKEND_BASE_URL
    string "GuangHeng Companion API base URL"
    default "https://43.155.204.194"
    help
        HTTPS endpoint for GuangHeng Control Plane. Do not enter a Home Assistant,
        MCP, Hermes, or model-provider endpoint here.

config GH_ALLOW_INSECURE_HTTP
    bool "Allow HTTP for private demo environment"
    default n
    help
        Development-only switch. Device credentials and approvals require HTTPS
        unless this is explicitly enabled for a controlled hackathon network.

config GH_SNTP_SERVER
    string "SNTP server used before production TLS"
    default "pool.ntp.org"
    help
        The first HTTPS request is blocked until SNTP establishes a trustworthy
        system time. TLS verification is never disabled to bypass time errors.

config GH_WIFI_SSID
    string "Wi-Fi SSID"
    default ""

config GH_WIFI_PASSWORD
    string "Wi-Fi password"
    default ""

config GH_DEVICE_ID
    string "Companion device identifier"
    default "gh-companion-dev-01"

config GH_HALL_ENABLED
    bool "Enable external TMAG5273"
    default n

config GH_HALL_I2C_PORT
    int "TMAG5273 I2C port"
    depends on GH_HALL_ENABLED
    default 0
    range 0 1

config GH_HALL_I2C_SDA
    int "TMAG5273 SDA GPIO"
    depends on GH_HALL_ENABLED
    default -1

config GH_HALL_I2C_SCL
    int "TMAG5273 SCL GPIO"
    depends on GH_HALL_ENABLED
    default -1

config GH_HALL_I2C_ADDRESS
    hex "TMAG5273 7-bit address"
    depends on GH_HALL_ENABLED
    default 0x35
    range 0x08 0x77

config GH_APPROVAL_HOLD_MS
    int "Approval long-press duration (ms)"
    default 1400
    range 1200 1500

config GH_BOOT_AUDIO_HIL
    bool "Play speaker tone and capture microphone during boot HIL"
    default n
    help
        Manufacturing/HIL-only check. Keep disabled in normal firmware so an
        ESP32-S3 reboot does not emit a speaker tone or delay startup. Runtime
        voice capture still initializes the real ES8311/I2S path.

endmenu
```

## sdkconfig.defaults
```kconfig
CONFIG_IDF_TARGET="esp32s3"
CONFIG_ESPTOOLPY_FLASHSIZE_16MB=y
CONFIG_SPIRAM=y
CONFIG_BSP_DISPLAY_LVGL_BUF_HEIGHT=20
CONFIG_SPIRAM_MODE_OCT=y
CONFIG_SPIRAM_SPEED_80M=y
CONFIG_SPIRAM_USE_MALLOC=y
CONFIG_COMPILER_OPTIMIZATION_PERF=y
CONFIG_FREERTOS_HZ=1000
CONFIG_ESP_MAIN_TASK_STACK_SIZE=8192
CONFIG_PARTITION_TABLE_CUSTOM=y
CONFIG_PARTITION_TABLE_CUSTOM_FILENAME="partitions.csv"
CONFIG_LV_USE_LOG=y
CONFIG_LV_FONT_MONTSERRAT_14=y
CONFIG_LV_FONT_MONTSERRAT_16=y
CONFIG_LV_FONT_MONTSERRAT_20=y
CONFIG_LV_FONT_MONTSERRAT_24=y
CONFIG_LV_FONT_MONTSERRAT_28=y
CONFIG_MBEDTLS_CERTIFICATE_BUNDLE=y
CONFIG_BT_ENABLED=y
CONFIG_BT_NIMBLE_ENABLED=y
CONFIG_BT_CONTROLLER_ENABLED=y
CONFIG_BT_NIMBLE_ROLE_CENTRAL=n
CONFIG_BT_NIMBLE_ROLE_OBSERVER=n
CONFIG_BT_NIMBLE_ROLE_PERIPHERAL=y
CONFIG_BT_NIMBLE_ROLE_BROADCASTER=y
CONFIG_BT_NIMBLE_GATT_SERVER=y
CONFIG_BT_NIMBLE_SECURITY_ENABLE=y
CONFIG_BT_NIMBLE_SM_SC=y
CONFIG_BT_NIMBLE_SM_SC_DEBUG_KEYS=n
CONFIG_BT_NIMBLE_NVS_PERSIST=y
CONFIG_BT_NIMBLE_MAX_CONNECTIONS=1
# Keep large TLS handshake/record allocations in the board's verified PSRAM.
# Internal DMA memory remains available for the CO5300 AMOLED SPI flush path.
# CONFIG_MBEDTLS_INTERNAL_MEM_ALLOC is not set
CONFIG_MBEDTLS_EXTERNAL_MEM_ALLOC=y
```
